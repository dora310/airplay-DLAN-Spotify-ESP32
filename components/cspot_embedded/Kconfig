## components/cspot_embedded/Kconfig
```kconfig
menu "Spotify Connect (experimental)"

    config SPOTIFY_CONNECT_ENABLE
        bool "Enable experimental Spotify Connect receiver"
        default y if IDF_TARGET_ESP32S3
        help
            Advertise this receiver in the Spotify app and decode Spotify
            Premium streams with the embedded cspot library. This is an
            unofficial experimental integration and may need updates if
            Spotify changes its service.

    if SPOTIFY_CONNECT_ENABLE

        config SPOTIFY_CONNECT_BITRATE
            int "Spotify Ogg/Vorbis bitrate (kbps)"
            range 96 320
            default 160

    endif

endmenu
```
